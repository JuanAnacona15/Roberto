//Incluimos las librerias para la pantalla OLED
#include <Wire.h>
#include <Adafruit_GFX.h>
#include <Adafruit_SSD1306.h>

//Se definen los pines para el Sensor Ultrasonico
#define TRIGGER_PIN  2
#define ECHO_PIN     3

//Se declara el ancho, alto, direccion y reset de la OLED
const uint8_t ancho = 128;
const uint8_t alto = 32;
const uint8_t direccion = 0X3C;
const int8_t oled_reset = -1;

//Se llama a la funcion para cpntruir la pantalla
Adafruit_SSD1306 display(ancho, alto, &Wire, oled_reset);

//Se define el tamaño del ojo del robot enn px
#define EYE_HEIGHT   32
#define EYE_WIDTH    32

int tapHand = 13;//Se declara una variable para interactuar con el robot
int tapState = 0;
bool wake = false;//Se declara una variable para encender al robot

//Se declaran las listas que contienen el codigo de los ojos del robot ----------------------------------
static const unsigned char PROGMEM Eye[] = {//Ojo normal
// 'Eye2', 32x32px
0x03, 0xff, 0xff, 0xc0, 0x07, 0xff, 0xff, 0xe0, 0x0f, 0xff, 0xff, 0xf0, 0x1f, 0xff, 0xff, 0xf8, 
0x3f, 0xff, 0xff, 0xf8, 0x3f, 0xff, 0xff, 0xfc, 0x3f, 0xff, 0xff, 0xfc, 0x3f, 0xff, 0xff, 0xfc, 
0x3f, 0xff, 0xff, 0xfc, 0x3f, 0xff, 0xff, 0xfc, 0x3f, 0xff, 0xff, 0xfc, 0x3f, 0xff, 0xff, 0xfc, 
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0x1f, 0xff, 0xff, 0xf8, 0x0f, 0xff, 0xff, 0xf0, 0x07, 0xff, 0xff, 0xe0, 0x01, 0xff, 0xff, 0x80};

//Se declara una lista con el codigo de el ojo feliz del robot
static const unsigned char PROGMEM Eye_happy[] = {//Ojo  feliz
// 'Eye4', 32x32px
0x07, 0xff, 0xff, 0xc0, 0x1f, 0xff, 0xff, 0xe0, 0x1f, 0xff, 0xff, 0xf0, 0x3f, 0xff, 0xff, 0xf8, 
0x7f, 0xff, 0xff, 0xf8, 0x7f, 0xff, 0xff, 0xfc, 0x7f, 0xff, 0xff, 0xfc, 0x7f, 0xff, 0xff, 0xfc, 
0x7f, 0xff, 0xff, 0xfc, 0x7f, 0xff, 0xff, 0xfc, 0x7f, 0xff, 0xff, 0xfc, 0x7f, 0xff, 0xff, 0xfc, 
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0x20, 0x00, 0x00, 0x08, 0x00, 0x00, 0x00, 0x00, 0x00, 0x00, 0x00, 0x00, 0x00, 0x00, 0x00, 0x00};  

static const unsigned char PROGMEM Eye_angry1[] = {//Ojo enojado izquierdo
// 'Eye_angry1', 32x32px
0x00, 0x00, 0x00, 0x00, 0x07, 0x00, 0x00, 0x00, 0x0f, 0x00, 0x00, 0x00, 0x1f, 0x80, 0x00, 0x00, 
0x3f, 0xe0, 0x00, 0x00, 0x7f, 0xf0, 0x00, 0x00, 0x7f, 0xfc, 0x00, 0x00, 0x7f, 0xff, 0x00, 0x00, 
0x7f, 0xff, 0xc0, 0x00, 0x7f, 0xff, 0xe0, 0x00, 0x7f, 0xff, 0xf8, 0x00, 0x7f, 0xff, 0xfe, 0x00, 
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0x3f, 0xff, 0xff, 0xfc, 0x1f, 0xff, 0xff, 0xf8, 0x0f, 0xff, 0xff, 0xf0, 0x03, 0xff, 0xff, 0xc0};

static const unsigned char PROGMEM Eye_angry2[] = {//Ojo enojado derecho
  // 'Eye_angry1', 32x32px
0x00, 0x00, 0x00, 0x00, 0x00, 0x00, 0x00, 0xe0, 0x00, 0x00, 0x00, 0xf0, 0x00, 0x00, 0x01, 0xf8, 
0x00, 0x00, 0x07, 0xfc, 0x00, 0x00, 0x0f, 0xfe, 0x00, 0x00, 0x3f, 0xfe, 0x00, 0x00, 0xff, 0xfe, 
0x00, 0x03, 0xff, 0xfe, 0x00, 0x07, 0xff, 0xfe, 0x00, 0x1f, 0xff, 0xfe, 0x00, 0x7f, 0xff, 0xfe, 
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0x3f, 0xff, 0xff, 0xfc, 0x1f, 0xff, 0xff, 0xf8, 0x0f, 0xff, 0xff, 0xf0, 0x03, 0xff, 0xff, 0xc0};

//Se define el ancho y alto del ojo cerrado del robot
#define EYE_CLOSED_HEIGHT   5
#define EYE_CLOSED_WIDTH    32
//Se declara la lista que contiene el codigo de el ojo cerrado del robot
static const unsigned char PROGMEM Closed_eye[] = {
// 'Eye3', 32x5px
0x7f, 0xff, 0xff, 0xfe, 0xff, 0xff, 0xff, 0xff, 0xff, 0xff, 0xff, 0xff, 0xff, 0xff, 0xff, 0xff, 
0x7f, 0xff, 0xff, 0xfe};

//-------------------------------------------------------------------------------------------------------

void setup() {
  Wire.begin();
  //Inicializamos los valores de la OLED
  display.begin(SSD1306_SWITCHCAPVCC, direccion); //generate oled.setTextColor(WHITE); // pantalla monocromatica
  display.setTextColor(WHITE);
  display.clearDisplay();
  display.display();

  //Se declaran los pines de lectura
  pinMode(tapHand, INPUT);//Se declara el pin de interacción con el robot
  pinMode(ECHO_PIN, INPUT);//Se declara el pin de entrada de la señal del Sensor ULS
  //Se declaran los pines de escritura
  pinMode(TRIGGER_PIN, OUTPUT);
  delay(1000);
}


void loop() { 
  for(int i=0; i<=6; i++){
      /*En este bucle:
        -Se calcula la distancia de un objeto
        -Se lee el pin de interacción con el robot
        -Se crean las condiciones para mostrar la cara ideal*/

   //Se calcula la distancia a un obstaculo ---------------------------
      // Limpiar el pin TRIGGER
      digitalWrite(TRIGGER_PIN, LOW);
      delayMicroseconds(2);
      // Generar un pulso en el pin TRIGGER
      digitalWrite(TRIGGER_PIN, HIGH);
      delayMicroseconds(10);
      digitalWrite(TRIGGER_PIN, LOW);
      // Leer el tiempo que tarda el pulso en regresar al pin ECHO
      long duration = pulseIn(ECHO_PIN, HIGH);
      // Calcular la distancia en centímetros
      long distance = duration / 29 / 2;
    //-------------------------------------------------------------------
      
      //Lee si se esta interactuando -----------------------
      tapState = digitalRead(tapHand);
      //---------------------------------------------------
      display.clearDisplay();
      //Sentencias logicas para mostrar la cara ideal ---------------------------------
      if(tapState == 1 && distance > 10){//Si no se interactua y no hay obstaculos
        //Se muestra una cara normal
        display.drawBitmap(32, 1, Eye, EYE_WIDTH, EYE_HEIGHT, WHITE);    
        display.drawBitmap(96, 1, Eye, EYE_WIDTH, EYE_HEIGHT, WHITE);
        display.display();
      }else if(tapState == 0 && distance > 10){//Si se interactua y no hay obstaculos
        //Se muestra cara feliz
        display.drawBitmap(32, 1, Eye_happy, EYE_WIDTH, EYE_HEIGHT, WHITE);      
        display.drawBitmap(96, 1, Eye_happy, EYE_WIDTH, EYE_HEIGHT, WHITE);
        display.display();
      }else if(distance < 10){//Si hay un obstaculo
        //Se muestra la cara enojada
        display.drawBitmap(32, 1, Eye_angry1, EYE_WIDTH, EYE_HEIGHT, WHITE);        
        display.drawBitmap(96, 1, Eye_angry2, EYE_WIDTH, EYE_HEIGHT, WHITE);
        display.display();
      }
      delay(500);
    }
    display.clearDisplay();
    display.drawBitmap(32, (display.height()/2), Closed_eye, EYE_CLOSED_WIDTH, EYE_CLOSED_HEIGHT, WHITE);
    display.display();
    display.drawBitmap(96, (display.height()/2), Closed_eye, EYE_CLOSED_WIDTH, EYE_CLOSED_HEIGHT, WHITE);
    display.display();
    delay(300);
  }
  
  
